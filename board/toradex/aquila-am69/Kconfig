## board/toradex/aquila-am69/Kconfig
```kconfig
# SPDX-License-Identifier: GPL-2.0-only
#
# Copyright 2024 Toradex
#

choice
	prompt "Toradex Aquila AM69 based boards"
	optional

config TARGET_AQUILA_AM69_A72
	bool "Toradex Aquila AM69 running on A72"
	select ARM64
	select SOC_K3_J784S4
	select SYS_DISABLE_DCACHE_OPS
	select BINMAN

config TARGET_AQUILA_AM69_R5
	bool "Toradex Aquila AM69 running on R5"
	select CPU_V7R
	select SYS_THUMB_BUILD
	select SOC_K3_J784S4
	select K3_LOAD_SYSFW
	select RAM
	select SPL_RAM
	select K3_DDRSS
	select BINMAN
	imply SYS_K3_SPL_ATF

endchoice

if TARGET_AQUILA_AM69_A72

config SYS_BOARD
       default "aquila-am69"

config SYS_VENDOR
       default "toradex"

config SYS_CONFIG_NAME
       default "aquila-am69"

config TDX_CFG_BLOCK
	default y

config TDX_CFG_BLOCK_2ND_ETHADDR
	default y

config TDX_CFG_BLOCK_DEV
	default "0"

config TDX_CFG_BLOCK_EXTRA
	default y

config TDX_CFG_BLOCK_OFFSET
	default "-512"

config TDX_CFG_BLOCK_PART
	default "1"

config TDX_HAVE_EEPROM_EXTRA
	default y

config TDX_HAVE_MMC
	default y

source "board/toradex/common/Kconfig"

endif

if TARGET_AQUILA_AM69_R5

config SYS_BOARD
       default "aquila-am69"

config SYS_VENDOR
       default "toradex"

config SYS_CONFIG_NAME
       default "aquila-am69"

config SPL_LDSCRIPT
	default "arch/arm/mach-omap2/u-boot-spl.lds"

endif
```
