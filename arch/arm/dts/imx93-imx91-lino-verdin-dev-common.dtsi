// SPDX-License-Identifier: GPL-2.0-or-later OR MIT
/*
 * Copyright (C) 2025 Toradex
 *
 * Lino iMX93/iMX91 SoM on Lino-Verdin Adapter / Development carrier board
 *
 * https://www.toradex.com/computer-on-modules/lino-arm-family/nxp-imx93
 * https://www.toradex.com/computer-on-modules/lino-arm-family/nxp-imx91
 * https://www.toradex.com/products/carrier-board/verdin-development-board-kit
 */

/* Lino ETH_1 */
&eqos {
	status = "okay";
};

/* Lino UART_3, used as the Linux Console */
&lpuart1 {
	status = "okay";
};

/* Lino USB_1 */
&usbotg1 {
	status = "okay";
};
