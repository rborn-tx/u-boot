// SPDX-License-Identifier: GPL-2.0-or-later OR MIT
/*
 * Copyright (C) 2025 Toradex
 *
 * Common dtsi for Verdin iMX95 SoM on development carrier board
 *
 * https://www.toradex.com/computer-on-modules/verdin-arm-family/nxp-imx95
 * https://www.toradex.com/products/carrier-board/verdin-development-board-kit
 */

/* Verdin ETH_1 (On-module PHY) */
&enetc_port0 {
	status = "okay";
};

/* Verdin UART_3, used as the Linux console */
&lpuart1 {
	status = "okay";
};

/* Verdin USB_1 */
&usb2 {
	status = "okay";
};
